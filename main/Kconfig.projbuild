## main/Kconfig.projbuild
```kconfig
menu "Self-definec Configuration"

    menu "Keys and LED on board"
        config LEFT_KEY_GPIO
            int "Left key GPIO number"
            range 0 48
            default 13
            help
                GPIO number (IOxx) to of left key

        config RIGHT_KEY_GPIO
            int "Right key GPIO number"
            range 0 48
            default 15
            help
                GPIO number (IOxx) to of right key

        choice Left_key_on_Board
            prompt "Left key function"
            default LEFT_KEY_CONTROL_PRIPHERAL
            help
                Defines the default function of keys.

            config LEFT_KEY_CONTROL_PRIPHERAL
                bool "Control pripheral"
            config LEFT_KEY_CONTROL_BOARD
                bool "Reset"
        endchoice
        
        choice Right_key_on_Board
            prompt "Right key function"
            default RIGHT_KEY_CONTROL_PRIPHERAL
            help
                Defines the default function of keys.

            config RIGHT_KEY_CONTROL_PRIPHERAL
                bool "Control pripheral"
            config RIGHT_KEY_CONTROL_BOARD
                bool "Boot"
        endchoice

        choice LED_on_Board
            prompt "LED control type"
            default KEY_CONTROL_LED
            help
                Defines the default peripheral for blink example

            config KEY_CONTROL_LED
                bool "Controlled by key"
            config BLINK_LED
                bool "Blink LED"
        endchoice

        choice Which_Key_Control_LED
            prompt "Which key to control LED"
            depends on KEY_CONTROL_LED
            default LEFT_KEY_CONTROL
            config LEFT_KEY_CONTROL
                bool "Left"
            config RIGHT_KEY_CONTROL
                bool "Right"
        endchoice
            
        config BLINK_PERIOD
            depends on BLINK_LED
            int "Blink period in ms"
            range 10 3600000
            default 1000
            help
                Define the blinking period in milliseconds.

        config LED_GPIO
            int "LED GPIO number"
            range 0 48
            default 23
            help
                GPIO number (IOxx) to blink on and off or the RMT signal for the addressable LED.
                Some GPIOs are used for other purposes (flash connections, etc.) and cannot be used to blink.
    endmenu

    menu "IoT Button"
    
        config BUTTON_PERIOD_TIME_MS
            int "BUTTON PERIOD TIME (MS)"
            range 2 20
            default 5
            help
                "Button scan interval"
    
        config BUTTON_DEBOUNCE_TICKS
            int "BUTTON DEBOUNCE TICKS"
            range 1 8
            default 2
    
        config BUTTON_SHORT_PRESS_TIME_MS
            int "BUTTON SHORT PRESS TIME (MS)"
            range 50 800
            default 100
    
        config BUTTON_LONG_PRESS_TIME_MS
            int "BUTTON LONG PRESS TIME (MS)"
            range 500 5000
            default 1000
    
        config ADC_BUTTON_MAX_CHANNEL
            int "ADC BUTTON MAX CHANNEL"
            range 1 5
            default 3
            help
                "Maximum number of channels for ADC buttons"
    
        config ADC_BUTTON_MAX_BUTTON_PER_CHANNEL
            int "ADC BUTTON MAX BUTTON PER CHANNEL"
            range 1 10
            default 8
            help
                "Maximum number of buttons per channel"
    
        config ADC_BUTTON_SAMPLE_TIMES
            int "ADC BUTTON SAMPLE TIMES"
            range 1 4
            default 1
            help
                "Number of samples per scan"
    
    endmenu
endmenu
```
